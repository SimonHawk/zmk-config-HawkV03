## boards/shields/hawkv03/Kconfig.defconfig
```kconfig
if SHIELD_HAWKV03_LEFT

config ZMK_KEYBOARD_NAME
    default "HawkV03"

config ZMK_SPLIT_ROLE_CENTRAL
    default y

endif # SHIELD_HAWKV03_LEFT

if SHIELD_HAWKV03_LEFT || SHIELD_HAWKV03_RIGHT

config ZMK_SPLIT
    default y

endif # SHIELD_HAWKV03_LEFT || SHIELD_HAWKV03_RIGHT
```

## boards/shields/hawkv03/Kconfig.shield
```kconfig
config SHIELD_HAWKV03_LEFT
    def_bool $(shields_list_contains,hawkv03_left)

config SHIELD_HAWKV03_RIGHT
    def_bool $(shields_list_contains,hawkv03_right)
```
